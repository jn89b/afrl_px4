## src/examples/px4_inject_myuorb/Kconfig
```kconfig
menuconfig EXAMPLES_PX4_INJECT_MYUORB
	bool "px4_inject_myuorb"
	default n
	---help---
		Enable support for px4_inject_myuorb
```

## src/modules/fw_att_pti/Kconfig
```kconfig
menuconfig MODULES_FW_ATT_PTI
	bool "fw_att_pti"
	default n
	---help---
		Enable support for fw_att_pti
```

## src/modules/supervisor_control/Kconfig
```kconfig
menuconfig MODULES_SUPERVISOR_CONTROL
	bool "supervisor_control"
	default n
	---help---
		Enable support for supervisor_control
```
